## CMakeLists.txt
```
#
# Copyright (c) 2023 Nordic Semiconductor ASA
#
# SPDX-License-Identifier: LicenseRef-Nordic-5-Clause
#

cmake_minimum_required(VERSION 3.20.0)

find_package(Zephyr REQUIRED HINTS $ENV{ZEPHYR_BASE})
project(nrf_wfa_qt_app)

target_compile_definitions(app PRIVATE -DCONFIG_CTRL_IFACE_ZEPHYR=y)
target_sources(app PRIVATE 
	src/events.c
	src/qt_app_main.c)
```

## Kconfig
```
#
# Copyright (c) 2023 Nordic Semiconductor
#
# SPDX-License-Identifier: LicenseRef-Nordic-5-Clause
#

source "samples/subsys/usb/common/Kconfig.sample_usbd"
source "Kconfig.zephyr"

menu "Nordic WFA QT sample"

config NET_CONFIG_USB_IPV4_ADDR
	string "USB IPv4 address"
	help
	  Static IPv4 address for USB interface

config NET_CONFIG_SLIP_IPV4_ADDR
	string "SLIP IPv4 address"
	help
	  Static IPv4 address for SLIP (Serial Line Internet Protocol) interface.

config NET_CONFIG_SLIP_IPV4_MASK
	string "SLIP IPv4 subnet mask"
	help
	  Static IPv4 subnet mask for SLIP (Serial Line Internet Protocol) interface.

config WFA_QT_SAMPLE_DHCPV4_POOL_START
	string "Start address of DHCPv4 pool"
	default "192.168.65.2"
	help
	  Set the start IP address of DHCPv4 pool.
endmenu
```

## sample.yaml
```
sample:
  description: WFA QuickTrack control application
  name: WFA QT App
tests:
  sample.nrf7002.wfa_qt_app:
    sysbuild: true
    build_only: true
    integration_platforms:
      - nrf7002dk/nrf5340/cpuapp
    platform_allow: nrf7002dk/nrf5340/cpuapp
    tags:
      - ci_build
      - sysbuild
      - ci_samples_wifi
  sample.nrf7002.enterprise_mode.wfa_qt_app.netusb:
    sysbuild: true
    build_only: true
    extra_args:
      - EXTRA_CONF_FILE="overlay-netusb.conf;overlay-enterprise.conf"
      - wfa_qt_app_SNIPPET="wifi-enterprise"
    integration_platforms:
      - nrf7002dk/nrf5340/cpuapp
    platform_allow: nrf7002dk/nrf5340/cpuapp
    tags:
      - ci_build
      - sysbuild
      - ci_samples_wifi
  sample.nrf7002.enterprise_mode.wfa_qt_app.slip:
    sysbuild: true
    build_only: true
    extra_args:
      - EXTRA_CONF_FILE="overlay-slip.conf;overlay-enterprise.conf"
      - EXTRA_DTC_OVERLAY_FILE="nrf7002_uart_pipe.overlay"
      - wfa_qt_app_SNIPPET="wifi-enterprise"
    integration_platforms:
      - nrf7002dk/nrf5340/cpuapp
    platform_allow: nrf7002dk/nrf5340/cpuapp
    tags:
      - ci_build
      - sysbuild
      - ci_samples_wifi
  sample.nrf7002_eks.wfa_qt_app:
    sysbuild: true
    build_only: true
    extra_args: SHIELD=nrf7002ek
    integration_platforms:
      - nrf5340dk/nrf5340/cpuapp
    platform_allow: nrf5340dk/nrf5340/cpuapp
    tags:
      - ci_build
      - sysbuild
      - ci_samples_wifi
  sample.nrf7002eb_interposer_p1.nrf7002eb.wfa_qt_app:
    sysbuild: true
    build_only: true
    extra_args:
      - wfa_qt_app_SHIELD="nrf7002eb_interposer_p1;nrf7002eb"
      - wfa_qt_app_SNIPPET=nrf70-wifi
      - EXTRA_CONF_FILE="overlay-usb-next.conf"
      - EXTRA_DTC_OVERLAY_FILE=usbd_next_ecm.overlay
    integration_platforms:
      - nrf54h20dk/nrf54h20/cpuapp
    platform_allow:
      - nrf54h20dk/nrf54h20/cpuapp
    tags:
      - ci_build
      - sysbuild
      - ci_samples_wifi
  sample.54lm20dk.nrf7002eb2.wfa_qt_app.netusb:
    sysbuild: true
    build_only: true
    extra_args:
      - wfa_qt_app_SHIELD="nrf7002eb2"
      - EXTRA_CONF_FILE="overlay-usb-next.conf"
      - EXTRA_DTC_OVERLAY_FILE=usbd_next_ecm.overlay
    integration_platforms:
      - nrf54lm20dk/nrf54lm20a/cpuapp
    platform_allow:
      - nrf54lm20dk/nrf54lm20a/cpuapp
    tags:
      - ci_build
      - sysbuild
      - ci_samples_wifi
  sample.54lm20dk.nrf7002eb2.wfa_qt_app.slip:
    sysbuild: true
    build_only: true
    extra_args:
      - wfa_qt_app_SHIELD="nrf7002eb2"
      - EXTRA_CONF_FILE="overlay-slip.conf"
      - EXTRA_DTC_OVERLAY_FILE="nrf54lm20_uart_pipe.overlay"
    integration_platforms:
      - nrf54lm20dk/nrf54lm20a/cpuapp
    platform_allow:
      - nrf54lm20dk/nrf54lm20a/cpuapp
    tags:
      - ci_build
      - sysbuild
      - ci_samples_wifi
```

## prj.conf
```kconfig
#
# Copyright (c) 2023 Nordic Semiconductor ASA
#
# SPDX-License-Identifier: LicenseRef-Nordic-5-Clause
#
CONFIG_WIFI=y
CONFIG_WIFI_NRF70=y
CONFIG_WFA_QT_CONTROL_APP=y
# Ideally this has to be done in the QT module, but we already override this in the
# hostap module (7), so, hostap will override QT module's settings, so, we have to
# override hostap's settings here.
CONFIG_ZVFS_OPEN_MAX=16

# WPA supplicant
CONFIG_WIFI_NM_WPA_SUPPLICANT=y
CONFIG_NET_L2_WIFI_SHELL=y
CONFIG_WIFI_NM_WPA_SUPPLICANT_ADVANCED_FEATURES=y

# System settings
CONFIG_COMMON_LIBC_MALLOC_ARENA_SIZE=40000

CONFIG_NET_CONFIG_INIT_TIMEOUT=0

# Networking
CONFIG_NETWORKING=y
CONFIG_NET_SOCKETS=y
CONFIG_NET_LOG=y
CONFIG_NET_IPV6=y
CONFIG_NET_IPV4=y
CONFIG_NET_UDP=y
CONFIG_NET_TCP=y
CONFIG_NET_DHCPV4=y
CONFIG_DNS_RESOLVER=y

CONFIG_NET_STATISTICS=y
CONFIG_NET_STATISTICS_WIFI=y
CONFIG_NET_STATISTICS_USER_API=y

CONFIG_NET_PKT_RX_COUNT=8
CONFIG_NET_PKT_TX_COUNT=8

# Below section is the primary contributor to SRAM and is currently
# tuned for performance, but this will be revisited in the future.
CONFIG_NET_BUF_RX_COUNT=16
CONFIG_NET_BUF_TX_COUNT=16
CONFIG_HEAP_MEM_POOL_SIZE=40144
CONFIG_NRF_WIFI_CTRL_HEAP_SIZE=20000
CONFIG_NRF_WIFI_DATA_HEAP_SIZE=123456
CONFIG_NET_TC_TX_COUNT=1

CONFIG_NET_IF_UNICAST_IPV6_ADDR_COUNT=4
CONFIG_NET_IF_MCAST_IPV6_ADDR_COUNT=5
CONFIG_NET_MAX_CONTEXTS=5
CONFIG_NET_CONTEXT_SYNC_RECV=y

CONFIG_INIT_STACKS=y

CONFIG_NET_L2_ETHERNET=y
CONFIG_NET_SHELL=y

# Memories
CONFIG_MAIN_STACK_SIZE=5200
CONFIG_SHELL_STACK_SIZE=5200
CONFIG_NET_TX_STACK_SIZE=4096
CONFIG_NET_RX_STACK_SIZE=4096

# Debugging
CONFIG_STACK_SENTINEL=y
CONFIG_DEBUG_COREDUMP=y
CONFIG_DEBUG_COREDUMP_BACKEND_LOGGING=y
CONFIG_DEBUG_COREDUMP_MEMORY_DUMP_MIN=y
CONFIG_SHELL_CMDS_RESIZE=n
#CONFIG_DEBUG=y
CONFIG_WIFI_NM_WPA_SUPPLICANT_LOG_LEVEL_INF=y

# Kernel options
CONFIG_ENTROPY_GENERATOR=y

# Logging
CONFIG_LOG=y
CONFIG_PRINTK=y
CONFIG_SHELL=y
CONFIG_SHELL_GETOPT=y
CONFIG_DEVICE_SHELL=y
CONFIG_POSIX_TIMERS=y
CONFIG_DATE_SHELL=y
CONFIG_NET_DHCPV4_SERVER=y
CONFIG_NET_CONFIG_AUTO_INIT=n
CONFIG_NET_CONFIG_SETTINGS=y

CONFIG_WIFI_CREDENTIALS=y
CONFIG_FLASH=y
CONFIG_FLASH_PAGE_LAYOUT=y
CONFIG_FLASH_MAP=y
CONFIG_NVS=y
CONFIG_SETTINGS=y
CONFIG_SETTINGS_NVS=y

# printing of scan results puts pressure on queues in new locking
# design in net_mgmt. So, use a typical number of networks in a crowded
# environment as the queue depth.
CONFIG_NET_MGMT_EVENT_QUEUE_SIZE=150
CONFIG_POSIX_API=y

CONFIG_SHELL_BACKEND_DUMMY=y

# Disabling it to enhance data packet reception and throughput
CONFIG_NRF_WIFI_LOW_POWER=n

# This is needed for WPA3 PMKSA caching test cases
CONFIG_WIFI_NM_WPA_SUPPLICANT_EAPOL=y
```

## overlay-usb-next.conf
```kconfig
CONFIG_USB_DEVICE_STACK_NEXT=y
CONFIG_USBD_CDC_ECM_CLASS=y

CONFIG_LOG=y
CONFIG_USBD_LOG_LEVEL_WRN=y
CONFIG_UDC_DRIVER_LOG_LEVEL_WRN=y
CONFIG_USBD_CDC_ECM_LOG_LEVEL_ERR=y
CONFIG_USBD_THREAD_STACK_SIZE=4096

CONFIG_SAMPLE_USBD_PID=0x0001
CONFIG_SAMPLE_USBD_PRODUCT="USBD CDC ECM sample"

# Number of IPv4 enabled network interfaces
CONFIG_NET_IF_MAX_IPV4_COUNT=2
CONFIG_NET_IF_UNICAST_IPV4_ADDR_COUNT=2
CONFIG_NET_CONFIG_USB_IPV4_ADDR="192.0.2.1"
CONFIG_ZVFS_POLL_MAX=8
```

## nrf54lm20_uart_pipe.overlay
```dts
/*
 * Copyright (c) 2025 Nordic Semiconductor ASA
 *
 * SPDX-License-Identifier: LicenseRef-Nordic-5-Clause
 */

 / {
	chosen {
		zephyr,uart-pipe = &uart20;
	};
};

&uart20 {
	compatible = "nordic,nrf-uarte";
	current-speed = <115200>;
	status = "okay";
	hw-flow-control;
};
```

## src/events.c
```c
/*
 * Copyright (c) 2024 Nordic Semiconductor ASA
 *
 * SPDX-License-Identifier: LicenseRef-Nordic-5-Clause
 */

/** @file
 * @brief WPA SUPP events
 */

#include <stdio.h>
#include <zephyr/net/net_event.h>
#include <ctrl_iface_zephyr.h>
#include <supp_events.h>
#include <utils.h>
#include <supp_main.h>

#define WPA_SUPP_EVENTS (NET_EVENT_WPA_SUPP_READY | \
			 NET_EVENT_WPA_SUPP_NOT_READY | \
			 NET_EVENT_WPA_SUPP_IFACE_ADDED | \
			 NET_EVENT_WPA_SUPP_CMD_IFACE_REMOVING | \
			 NET_EVENT_WPA_SUPP_CMD_IFACE_REMOVED)

static struct net_mgmt_event_callback net_wpa_supp_cb;
struct wpa_supplicant *wpa_s = NULL;

K_SEM_DEFINE(wpa_supp_ready_sem, 0, 1);

static void handle_wpa_supp_ready(struct net_mgmt_event_callback *cb)
{
	int retry_count = 0;
retry:
	wpa_s = z_wpas_get_handle_by_ifname("wlan0");
	if (!wpa_s && retry_count++ < 5) {
		printf("%s: Unable to get wpa_s handle for %s\n",
			      __func__, "wlan0");
		goto retry;
	}

	if (!wpa_s) {
		printf("%s: Unable to get wpa_s handle for %s\n",
				__func__, "wlan0");
	}

	k_sem_give(&wpa_supp_ready_sem);

}

static void wpa_supp_event_handler(struct net_mgmt_event_callback *cb,
                                    uint32_t mgmt_event, struct net_if *iface)
{
        switch (mgmt_event) {
        case NET_EVENT_WPA_SUPP_READY:
		printf("Supplicant is ready");
		handle_wpa_supp_ready(cb);
                break;
	case NET_EVENT_WPA_SUPP_NOT_READY:
		printf("Supplicant is not ready");
                break;
	case  NET_EVENT_WPA_SUPP_IFACE_ADDED:
		printf("Interface added");
                break;
	case NET_EVENT_WPA_SUPP_CMD_IFACE_REMOVING:
		printf("Interface is removing");
                break;
	case NET_EVENT_WPA_SUPP_CMD_IFACE_REMOVED:
		printf("Interface removed");
                break;
        default:
                break;
        }
}

int wpa_supp_events_init(void)
{
	net_mgmt_init_event_callback(&net_wpa_supp_cb,
                                     wpa_supp_event_handler,
                                     WPA_SUPP_EVENTS);
        net_mgmt_add_event_callback(&net_wpa_supp_cb);

	k_sem_take(&wpa_supp_ready_sem, K_FOREVER);

	/* Check for ctrl_iface initialization */
	if (wpa_s->ctrl_iface->sock_pair[0] < 0) {
		return -1;
	}

	return 0;
}
```

## src/qt_app_main.c
```c
/*
 * Copyright (c) 2023 Nordic Semiconductor ASA
 *
 * SPDX-License-Identifier: LicenseRef-Nordic-5-Clause
 */

/** @file
 * @brief WiFi QT control app main file.
 */

#include <zephyr/sys/printk.h>
#include <zephyr/kernel.h>
#if NRFX_CLOCK_ENABLED && (defined(CLOCK_FEATURE_HFCLK_DIVIDE_PRESENT) || NRF_CLOCK_HAS_HFCLK192M)
#include <nrfx_clock.h>
#endif
#include <zephyr/device.h>
#include <zephyr/net/net_config.h>

#if defined(CONFIG_USB_DEVICE_STACK) || defined(CONFIG_USB_DEVICE_STACK_NEXT)
#include <zephyr/usb/usb_device.h>
#include <zephyr/usb/usbd.h>
#include <sample_usbd.h>

int init_usb(void)
{
	int ret;

#ifdef CONFIG_USB_DEVICE_STACK
	ret = usb_enable(NULL);
#else
	struct usbd_context *sample_usbd = sample_usbd_init_device(NULL);
	ret = usbd_enable(sample_usbd);
#endif /* CONFIG_USB_DEVICE_STACK */
	if (ret != 0) {
		printk("Cannot enable USB (%d)", ret);
		return ret;
	}

	return 0;
}
#endif /* CONFIG_USB_DEVICE_STACK || CONFIG_USB_DEVICE_STACK_NEXT */

int main(void)
{
#if NRFX_CLOCK_ENABLED && (defined(CLOCK_FEATURE_HFCLK_DIVIDE_PRESENT) || NRF_CLOCK_HAS_HFCLK192M)
	/* For now hardcode to 128MHz */
	nrfx_clock_divider_set(NRF_CLOCK_DOMAIN_HFCLK,
			       NRF_CLOCK_HFCLK_DIV_1);
#endif
	printk("Starting %s with CPU frequency: %d MHz\n", CONFIG_BOARD, SystemCoreClock/MHZ(1));

#if defined(CONFIG_USB_DEVICE_STACK) || defined(CONFIG_USB_DEVICE_STACK_NEXT)
	struct in_addr addr = {0};
	struct in_addr mask;

	init_usb();
#ifdef CONFIG_USB_DEVICE_STACK
	/* Redirect static IP address to netusb*/
	const struct device *usb_dev = device_get_binding("eth_netusb");
#else
	const struct device *usb_dev = device_get_binding("cdc_ecm_eth0");
#endif /* CONFIG_USB_DEVICE_STACK */
	struct net_if *iface = net_if_lookup_by_dev(usb_dev);

	if (!iface) {
		printk("Cannot find network interface: %s", "eth_netusb");
		return -1;
	}
	if (sizeof(CONFIG_NET_CONFIG_USB_IPV4_ADDR) > 1) {
		if (net_addr_pton(AF_INET, CONFIG_NET_CONFIG_USB_IPV4_ADDR, &addr)) {
			printk("Invalid address: %s", CONFIG_NET_CONFIG_USB_IPV4_ADDR);
			return -1;
		}
		net_if_ipv4_addr_add(iface, &addr, NET_ADDR_MANUAL, 0);
	}
	if (sizeof(CONFIG_NET_CONFIG_MY_IPV4_NETMASK) > 1) {
		/* If not empty */
		if (net_addr_pton(AF_INET, CONFIG_NET_CONFIG_MY_IPV4_NETMASK, &mask)) {
			printk("Invalid netmask: %s", CONFIG_NET_CONFIG_MY_IPV4_NETMASK);
		} else {
			net_if_ipv4_set_netmask_by_addr(iface, &addr, &mask);
		}
	}
#endif /* CONFIG_USB_DEVICE_STACK || CONFIG_USB_DEVICE_STACK_NEXT */

#ifdef CONFIG_SLIP
	const struct device *slip_dev = device_get_binding(CONFIG_SLIP_DRV_NAME);
	struct net_if *slip_iface = net_if_lookup_by_dev(slip_dev);

	if (!slip_iface) {
		printk("Cannot find network interface: %s", CONFIG_SLIP_DRV_NAME);
		return -1;
	}

	if (sizeof(CONFIG_NET_CONFIG_SLIP_IPV4_ADDR) > 1) {
		if (net_addr_pton(AF_INET, CONFIG_NET_CONFIG_SLIP_IPV4_ADDR, &addr)) {
			printk("Invalid address: %s", CONFIG_NET_CONFIG_SLIP_IPV4_ADDR);
			return -1;
		}
		net_if_ipv4_addr_add(slip_iface, &addr, NET_ADDR_MANUAL, 0);
	}

	if (sizeof(CONFIG_NET_CONFIG_SLIP_IPV4_MASK) > 1) {
		/* If not empty */
		if (net_addr_pton(AF_INET, CONFIG_NET_CONFIG_SLIP_IPV4_MASK, &mask)) {
			printk("Invalid netmask: %s", CONFIG_NET_CONFIG_SLIP_IPV4_MASK);
		} else {
			net_if_ipv4_set_netmask_by_addr(slip_iface, &addr, &mask);
		}
	}
#endif /* CONFIG_SLIP */

#ifdef CONFIG_NET_CONFIG_SETTINGS
	/* Without this, DHCPv4 starts on first interface and if that is not Wi-Fi or
	 * only supports IPv6, then its an issue. (E.g., OpenThread)
	 *
	 * So, we start DHCPv4 on Wi-Fi interface always, independent of the ordering.
	 */
	const struct device *dev = DEVICE_DT_GET(DT_CHOSEN(zephyr_wifi));
	struct net_if *wifi_iface = net_if_lookup_by_dev(dev);

	if (!wifi_iface) {
		printk("Cannot find network interface: %s", "wlan0");
		return -1;
	}
	if (sizeof(CONFIG_NET_CONFIG_MY_IPV4_ADDR) > 1) {
		if (net_addr_pton(AF_INET, CONFIG_NET_CONFIG_MY_IPV4_ADDR, &addr)) {
			printk("Invalid address: %s", CONFIG_NET_CONFIG_MY_IPV4_ADDR);
			return -1;
		}
		net_if_ipv4_addr_add(wifi_iface, &addr, NET_ADDR_MANUAL, 0);
	}
	if (sizeof(CONFIG_NET_CONFIG_MY_IPV4_NETMASK) > 1) {
		/* If not empty */
		if (net_addr_pton(AF_INET, CONFIG_NET_CONFIG_MY_IPV4_NETMASK, &mask)) {
			printk("Invalid netmask: %s", CONFIG_NET_CONFIG_MY_IPV4_NETMASK);
		} else {
			net_if_ipv4_set_netmask_by_addr(wifi_iface, &addr, &mask);
		}
	}

	/* As both are Ethernet, we need to set specific interface*/
	net_if_set_default(wifi_iface);

	net_config_init_app(dev, "Initializing network");
#endif

	return 0;
}
```
