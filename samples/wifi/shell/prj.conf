## CMakeLists.txt
```
#
# Copyright (c) 2022 Nordic Semiconductor ASA
#
# SPDX-License-Identifier: LicenseRef-Nordic-5-Clause
#

cmake_minimum_required(VERSION 3.20.0)

find_package(Zephyr REQUIRED HINTS $ENV{ZEPHYR_BASE})
project(nrf_wifi_shell)

target_sources(app PRIVATE
	src/main.c
	src/wifi_raw_tx_packet_shell.c)
```

## Kconfig
```
#
# Copyright (c) 2022 Nordic Semiconductor
#
# SPDX-License-Identifier: LicenseRef-Nordic-5-Clause
#

source "Kconfig.zephyr"

menu "Nordic SHELL sample"

config NRF7002_QUICK_TRACK
	bool "Flag to compile zephyr code"
	default n
endmenu

config WFA_QT_THREAD_STACK_SIZE
	int "Thread stack size"
	default 4096
	help
	  Thread stack size.
```

## sample.yaml
```
sample:
  description: Wi-Fi shell sample application
  name: Wi-Fi shell
tests:
  sample.nrf7002.shell:
    sysbuild: true
    build_only: true
    integration_platforms:
      - nrf7002dk/nrf5340/cpuapp
    platform_allow: nrf7002dk/nrf5340/cpuapp
    tags:
      - ci_build
      - sysbuild
      - ci_samples_wifi
  # Disable optional features to reduce memory usage
  sample.nrf7002.shell.disable_adv_features:
    sysbuild: true
    build_only: true
    extra_args: -DCONFIG_WIFI_NM_WPA_SUPPLICANT_ADVANCED_FEATURES=n
    integration_platforms:
      - nrf7002dk/nrf5340/cpuapp
    platform_allow: nrf7002dk/nrf5340/cpuapp
    tags:
      - ci_build
      - sysbuild
      - ci_samples_wifi
  sample.nrf7001.shell:
    sysbuild: true
    build_only: true
    integration_platforms:
      - nrf7002dk/nrf5340/cpuapp/nrf7001
    platform_allow: nrf7002dk/nrf5340/cpuapp/nrf7001
    tags:
      - ci_build
      - sysbuild
      - ci_samples_wifi
  sample.nrf7002_eks.shell:
    sysbuild: true
    build_only: true
    extra_args: SHIELD=nrf7002ek
    integration_platforms:
      - nrf5340dk/nrf5340/cpuapp
      - nrf52840dk/nrf52840
    platform_allow:
      - nrf5340dk/nrf5340/cpuapp
      - nrf52840dk/nrf52840
    tags:
      - ci_build
      - sysbuild
      - ci_samples_wifi
  sample.nrf7000_eks.shell:
    sysbuild: true
    build_only: true
    extra_args:
      - SHIELD=nrf7002ek_nrf7000
      - CONFIG_WIFI_NM_WPA_SUPPLICANT=n
      - SB_CONFIG_WIFI_NRF70_SCAN_ONLY=y
      - CONFIG_NET_CONNECTION_MANAGER=n
    integration_platforms:
      - nrf5340dk/nrf5340/cpuapp
      - nrf52840dk/nrf52840
    platform_allow:
      - nrf5340dk/nrf5340/cpuapp
      - nrf52840dk/nrf52840
    tags:
      - ci_build
      - sysbuild
      - ci_samples_wifi
  sample.nrf7001_eks.shell:
    sysbuild: true
    build_only: true
    extra_args: SHIELD=nrf7002ek_nrf7001
    integration_platforms:
      - nrf5340dk/nrf5340/cpuapp
      - nrf52840dk/nrf52840
    platform_allow:
      - nrf5340dk/nrf5340/cpuapp
      - nrf52840dk/nrf52840
    tags:
      - ci_build
      - sysbuild
      - ci_samples_wifi
  sample.nrf7002_eks_cpunet.shell:
    sysbuild: true
    build_only: true
    extra_args:
      - SHIELD=nrf7002ek
      - CONFIG_SOC_NRF53_CPUNET_ENABLE=y
    integration_platforms:
      - nrf5340dk/nrf5340/cpuapp
    platform_allow: nrf5340dk/nrf5340/cpuapp
    tags:
      - ci_build
      - sysbuild
      - ci_samples_wifi
  sample.nrf7000_eks_cpunet.shell:
    sysbuild: true
    build_only: true
    extra_args:
      - SHIELD=nrf7002ek_nrf7000
      - CONFIG_SOC_NRF53_CPUNET_ENABLE=y
      - CONFIG_WIFI_NM_WPA_SUPPLICANT=n
      - SB_CONFIG_WIFI_NRF70_SCAN_ONLY=y
      - CONFIG_NET_CONNECTION_MANAGER=n
    integration_platforms:
      - nrf5340dk/nrf5340/cpuapp
    platform_allow: nrf5340dk/nrf5340/cpuapp
    tags:
      - ci_build
      - sysbuild
      - ci_samples_wifi
  sample.nrf7001_eks_cpunet.shell:
    sysbuild: true
    build_only: true
    extra_args:
      - SHIELD=nrf7002ek_nrf7001
      - CONFIG_SOC_NRF53_CPUNET_ENABLE=y
    integration_platforms:
      - nrf5340dk/nrf5340/cpuapp
    platform_allow: nrf5340dk/nrf5340/cpuapp
    tags:
      - ci_build
      - sysbuild
      - ci_samples_wifi
  sample.nrf7002.shell.zperf:
    sysbuild: true
    build_only: true
    extra_args: EXTRA_CONF_FILE=overlay-zperf.conf
    integration_platforms:
      - nrf7002dk/nrf5340/cpuapp
    platform_allow: nrf7002dk/nrf5340/cpuapp
    tags:
      - ci_build
      - sysbuild
      - ci_samples_wifi
  sample.nrf7001.shell.zperf:
    sysbuild: true
    build_only: true
    extra_args: EXTRA_CONF_FILE=overlay-zperf.conf
    integration_platforms:
      - nrf7002dk/nrf5340/cpuapp/nrf7001
    platform_allow: nrf7002dk/nrf5340/cpuapp/nrf7001
    tags:
      - ci_build
      - sysbuild
      - ci_samples_wifi
  sample.nrf7002.shell.wpa_cli:
    sysbuild: true
    build_only: true
    extra_args: CONFIG_WPA_CLI=y
    integration_platforms:
      - nrf7002dk/nrf5340/cpuapp
    platform_allow: nrf7002dk/nrf5340/cpuapp
    tags:
      - ci_build
      - sysbuild
      - ci_samples_wifi
  sample.nrf7001.shell.wpa_cli:
    sysbuild: true
    build_only: true
    extra_args: CONFIG_WPA_CLI=y
    integration_platforms:
      - nrf7002dk/nrf5340/cpuapp/nrf7001
    platform_allow: nrf7002dk/nrf5340/cpuapp/nrf7001
    tags:
      - ci_build
      - sysbuild
      - ci_samples_wifi
  sample.nrf7002.shell.scan_only_7002:
    sysbuild: true
    build_only: true
    extra_args:
      - EXTRA_CONF_FILE=overlay-scan-only.conf
      - SB_CONFIG_WIFI_NRF70_SCAN_ONLY=y
    integration_platforms:
      - nrf7002dk/nrf5340/cpuapp
    platform_allow: nrf7002dk/nrf5340/cpuapp
    tags:
      - ci_build
      - sysbuild
      - ci_samples_wifi
  sample.nrf7000.shell.scan_only_91:
    sysbuild: true
    build_only: true
    extra_args:
      - EXTRA_CONF_FILE=overlay-scan-only.conf
      - SHIELD=nrf7002ek_nrf7000
      - CONFIG_WIFI_NM_WPA_SUPPLICANT=n
      - SB_CONFIG_WIFI_NRF70_SCAN_ONLY=y
    integration_platforms:
      - nrf9160dk/nrf9160/ns
      - nrf9161dk/nrf9161/ns
    platform_allow:
      - nrf9160dk/nrf9160/ns
      - nrf9161dk/nrf9161/ns
      - nrf9151dk/nrf9151/ns
    tags:
      - ci_build
      - sysbuild
      - ci_samples_wifi
  sample.nrf7002.shell.scan_only_thingy91x:
    sysbuild: true
    build_only: true
    extra_args:
      - EXTRA_CONF_FILE=overlay-scan-only.conf
      - SB_CONFIG_WIFI_NRF70_SCAN_ONLY=y
    platform_allow:
      - thingy91x/nrf9151/ns
    tags:
      - ci_build
      - sysbuild
      - ci_samples_wifi
  sample.nrf7002.shell.full_stack_thingy91x:
    sysbuild: true
    build_only: true
    extra_args: SB_CONFIG_THINGY91X_STATIC_PARTITIONS_NRF53_EXTERNAL_FLASH=y
    platform_allow:
      - thingy91x/nrf5340/cpuapp
    tags:
      - ci_build
      - sysbuild
      - ci_samples_wifi
  sample.nrf7002.shell.otbr:
    sysbuild: true
    build_only: true
    extra_args:
      - EXTRA_CONF_FILE=overlay-openthread.conf
      - SB_CONFIG_NETCORE_IPC_RADIO=y
      - SB_CONFIG_NETCORE_IPC_RADIO_IEEE802154=y
    integration_platforms:
      - nrf7002dk/nrf5340/cpuapp
    platform_allow: nrf7002dk/nrf5340/cpuapp
    tags:
      - ci_build
      - sysbuild
      - ci_samples_wifi
  sample.nrf7002_ns.shell:
    sysbuild: true
    build_only: true
    platform_allow: nrf7002dk/nrf5340/cpuapp/ns
    tags:
      - sysbuild
      - ci_samples_wifi
  sample.nrf7002_eb.thingy53.shell:
    sysbuild: true
    build_only: true
    extra_args:
      - shell_SHIELD=nrf7002eb
      - CONFIG_SOC_NRF53_CPUNET_ENABLE=y
    integration_platforms:
      - thingy53/nrf5340/cpuapp
    platform_allow: thingy53/nrf5340/cpuapp
    tags:
      - ci_build
      - sysbuild
      - ci_samples_wifi
  sample.qspi.ext_flash_xip:
    sysbuild: true
    build_only: true
    extra_args:
      - shell_SHIELD=nrf7002ek
      - SB_CONFIG_WIFI_PATCHES_EXT_FLASH_XIP=y
      - SB_CONFIG_PARTITION_MANAGER=n
    integration_platforms:
      - nrf5340dk/nrf5340/cpuapp
      - nrf52840dk/nrf52840
    platform_allow:
      - nrf5340dk/nrf5340/cpuapp
      - nrf52840dk/nrf52840
    tags:
      - ci_build
      - sysbuild
      - ci_samples_wifi
  sample.qspi.ext_flash_store:
    sysbuild: true
    build_only: true
    extra_args:
      - shell_SHIELD=nrf7002ek
      - shell_SNIPPET=nrf70-fw-patch-ext-flash
    integration_platforms:
      - nrf5340dk/nrf5340/cpuapp
      - nrf52840dk/nrf52840
    platform_allow:
      - nrf5340dk/nrf5340/cpuapp
      - nrf52840dk/nrf52840
    tags:
      - ci_build
      - sysbuild
      - ci_samples_wifi
  sample.spi.ext_flash_store:
    sysbuild: true
    build_only: true
    extra_args:
      - SNIPPET=nrf70-fw-patch-ext-flash
    integration_platforms:
      - nrf7002dk/nrf5340/cpuapp
    platform_allow:
      - nrf7002dk/nrf5340/cpuapp
    tags:
      - ci_build
      - sysbuild
      - ci_samples_wifi
  sample.nrf7002eb_interposer_p1.nrf7002eb.shell:
    sysbuild: true
    build_only: true
    extra_args:
      - shell_SHIELD="nrf7002eb_interposer_p1;nrf7002eb"
      - shell_SNIPPET=nrf70-wifi
    integration_platforms:
      - nrf54h20dk/nrf54h20/cpuapp
      - nrf54l15dk/nrf54l15/cpuapp
    platform_allow:
      - nrf54h20dk/nrf54h20/cpuapp
      - nrf54l15dk/nrf54l15/cpuapp
    tags:
      - ci_build
      - sysbuild
      - ci_samples_wifi
  sample.nrf7002eb_interposer_p1.nrf7002eb.shell.superset:
    sysbuild: true
    build_only: true
    extra_args:
      - shell_SHIELD="nrf7002eb_interposer_p1;nrf7002eb"
      - shell_SNIPPET=nrf70-wifi
      - EXTRA_CONF_FILE=overlay-zperf.conf
      - CONFIG_NRF70_UTIL=y
      - CONFIG_WPA_CLI=y
      - CONFIG_NET_IPV4_FRAGMENT=y
      - CONFIG_NET_IPV4_FRAGMENT_MAX_PKT=24
      - CONFIG_NRF_WIFI_DATA_HEAP_SIZE=199000
    integration_platforms:
      - nrf54h20dk/nrf54h20/cpuapp
    platform_allow:
      - nrf54h20dk/nrf54h20/cpuapp
    tags:
      - ci_build
      - sysbuild
      - ci_samples_wifi
  sample.nrf7002eb2.shell:
    sysbuild: true
    build_only: true
    extra_args:
      - shell_SHIELD="nrf7002eb2"
      - SNIPPET=nrf70-wifi
    integration_platforms:
      - nrf54h20dk/nrf54h20/cpuapp
      - nrf54l15dk/nrf54l15/cpuapp
    platform_allow:
      - nrf54h20dk/nrf54h20/cpuapp
      - nrf54l15dk/nrf54l15/cpuapp
    tags:
      - ci_build
      - sysbuild
      - ci_samples_wifi
  sample.54lm20pdk.nrf7002eb2.shell:
    sysbuild: true
    build_only: true
    extra_args:
      - shell_SHIELD="nrf7002eb2"
    integration_platforms:
      - nrf54lm20pdk@0.2.0.csp/nrf54lm20a/cpuapp
    platform_allow:
      - nrf54lm20pdk@0.2.0.csp/nrf54lm20a/cpuapp
    tags:
      - ci_build
      - sysbuild
      - ci_samples_wifi
  # Used by QA and also acts as a memory stress test
  sample.nrf7001.superset:
    sysbuild: true
    build_only: true
    extra_args:
      - EXTRA_CONF_FILE=overlay-zperf.conf
      - CONFIG_NRF70_UTIL=y
      - CONFIG_WPA_CLI=y
      - CONFIG_NET_IPV4_FRAGMENT=y
      - CONFIG_NET_IPV4_FRAGMENT_MAX_PKT=24
    integration_platforms:
      - nrf7002dk/nrf5340/cpuapp/nrf7001
    platform_allow: nrf7002dk/nrf5340/cpuapp/nrf7001
    tags:
      - ci_build_superset
      - sysbuild
      - ci_samples_wifi
  # Used by QA and also acts as a memory stress test
  sample.nrf7001_ek.superset:
    sysbuild: true
    build_only: true
    extra_args:
      - SHIELD=nrf7002ek_nrf7001
      - EXTRA_CONF_FILE=overlay-zperf.conf
      - CONFIG_NRF70_UTIL=y
      - CONFIG_WPA_CLI=y
      - CONFIG_NET_IPV4_FRAGMENT=y
      - CONFIG_NET_IPV4_FRAGMENT_MAX_PKT=24
    integration_platforms:
      - nrf5340dk/nrf5340/cpuapp
    platform_allow: nrf5340dk/nrf5340/cpuapp
    tags:
      - ci_build_superset
      - sysbuild
      - ci_samples_wifi
  # Used by QA and also acts as a memory stress test
  sample.nrf7002.superset:
    sysbuild: true
    build_only: true
    extra_args:
      - EXTRA_CONF_FILE=overlay-zperf.conf
      - CONFIG_NRF70_UTIL=y
      - CONFIG_WPA_CLI=y
      - CONFIG_NET_IPV4_FRAGMENT=y
      - CONFIG_NET_IPV4_FRAGMENT_MAX_PKT=24
    integration_platforms:
      - nrf7002dk/nrf5340/cpuapp
    platform_allow: nrf7002dk/nrf5340/cpuapp
    tags:
      - ci_build_superset
      - sysbuild
      - ci_samples_wifi
  # Used by QA and also acts as a memory stress test
  sample.nrf7002_ek.superset:
    sysbuild: true
    build_only: true
    extra_args:
      - SHIELD=nrf7002ek
      - EXTRA_CONF_FILE=overlay-zperf.conf
      - CONFIG_NRF70_UTIL=y
      - CONFIG_WPA_CLI=y
      - CONFIG_NET_IPV4_FRAGMENT=y
      - CONFIG_NET_IPV4_FRAGMENT_MAX_PKT=24
    integration_platforms:
      - nrf5340dk/nrf5340/cpuapp
    platform_allow: nrf5340dk/nrf5340/cpuapp
    tags:
      - ci_build_superset
      - sysbuild
      - ci_samples_wifi
  sample.nrf7002.superset.debug:
    sysbuild: true
    build_only: true
    extra_args:
      - shell_SNIPPET="nrf70-driver-verbose-debug;wpa-supplicant-debug"
      - EXTRA_CONF_FILE=overlay-zperf.conf
      - CONFIG_NRF70_UTIL=y
      - CONFIG_WPA_CLI=y
      - CONFIG_NET_IPV4_FRAGMENT=y
      - CONFIG_NET_IPV4_FRAGMENT_MAX_PKT=24
    integration_platforms:
      - nrf7002dk/nrf5340/cpuapp
    platform_allow: nrf7002dk/nrf5340/cpuapp
    tags:
      - ci_build_superset
      - sysbuild
      - ci_samples_wifi
  sample.nrf7002.enterprise_mode:
    sysbuild: true
    build_only: true
    extra_args: shell_SNIPPET=wifi-enterprise
    integration_platforms:
      - nrf7002dk/nrf5340/cpuapp
    platform_allow: nrf7002dk/nrf5340/cpuapp
    tags:
      - ci_build
      - sysbuild
      - ci_samples_wifi
  sample.nrf7002.ap:
    sysbuild: true
    build_only: true
    extra_args: EXTRA_CONF_FILE=overlay-sap.conf
    integration_platforms:
      - nrf7002dk/nrf5340/cpuapp
    platform_allow: nrf7002dk/nrf5340/cpuapp
    tags:
      - ci_build
      - sysbuild
      - ci_samples_wifi
  sample.nrf7002.with_overlay_raw_tx_packet:
    sysbuild: true
    build_only: true
    extra_args:
      - EXTRA_CONF_FILE=overlay-raw-tx.conf
      - SB_CONFIG_WIFI_NRF70_SYSTEM_WITH_RAW_MODES=y
    integration_platforms:
      - nrf7002dk/nrf5340/cpuapp
    platform_allow: nrf7002dk/nrf5340/cpuapp
    tags:
      - ci_build
      - sysbuild
      - ci_samples_wifi
  sample.nrf7002.with_overlay_monitor:
    sysbuild: true
    build_only: true
    extra_args:
      - EXTRA_CONF_FILE=overlay-monitor-mode.conf
      - SB_CONFIG_WIFI_NRF70_SYSTEM_WITH_RAW_MODES=y
    integration_platforms:
      - nrf7002dk/nrf5340/cpuapp
    platform_allow: nrf7002dk/nrf5340/cpuapp
    tags:
      - ci_build
      - sysbuild
      - ci_samples_wifi
  sample.nrf7002.promiscuous_mode:
    sysbuild: true
    build_only: true
    extra_args:
      - EXTRA_CONF_FILE=overlay-promiscuous-mode.conf
      - SB_CONFIG_WIFI_NRF70_SYSTEM_WITH_RAW_MODES=y
    integration_platforms:
      - nrf7002dk/nrf5340/cpuapp
    platform_allow: nrf7002dk/nrf5340/cpuapp
    tags:
      - ci_build
      - sysbuild
      - ci_samples_wifi
  sample.nrf7001.promiscuous_mode_7001:
    sysbuild: true
    build_only: true
    extra_args:
      - EXTRA_CONF_FILE=overlay-promiscuous-mode.conf
      - SB_CONFIG_WIFI_NRF70_SYSTEM_WITH_RAW_MODES=y
    integration_platforms:
      - nrf7002dk/nrf5340/cpuapp/nrf7001
    platform_allow: nrf7002dk/nrf5340/cpuapp/nrf7001
    tags:
      - ci_build
      - sysbuild
      - ci_samples_wifi
  sample.nrf7002.shell.psa:
    build_only: true
    extra_args: CONFIG_HOSTAP_CRYPTO_ALT_LEGACY_PSA=y
    integration_platforms:
      - nrf7002dk/nrf5340/cpuapp
    platform_allow: nrf7002dk/nrf5340/cpuapp
    tags:
      - ci_build
      - sysbuild
      - ci_samples_wifi
  sample.nrf54l15.softap.superset:
    sysbuild: true
    build_only: true
    extra_args:
      - softap_SHIELD="nrf7002eb_interposer_p1;nrf7002eb"
      - softap_SNIPPET=nrf70-wifi
      - CONFIG_HEAP_MEM_POOL_IGNORE_MIN=n
    integration_platforms:
      - nrf54l15dk/nrf54l15/cpuapp
    platform_allow:
      - nrf54l15dk/nrf54l15/cpuapp
    tags:
      - ci_build
      - sysbuild
      - ci_samples_wifi
```

## prj.conf
```kconfig
#
# Copyright (c) 2022 Nordic Semiconductor ASA
#
# SPDX-License-Identifier: LicenseRef-Nordic-5-Clause
#
CONFIG_WIFI=y
CONFIG_WIFI_NRF700X=y

# WPA supplicant
CONFIG_WPA_SUPP=y
CONFIG_NET_L2_WIFI_SHELL=y
CONFIG_WPA_CLI=y

# System settings
CONFIG_NEWLIB_LIBC=y
# changed based on wfa_dut usb commit
CONFIG_NEWLIB_LIBC_NANO=y

# Workaround for Linux based system calls
CONFIG_FILE_SYSTEM=y
CONFIG_POSIX_FS=y

# Networking
CONFIG_NETWORKING=y
CONFIG_NET_SOCKETS=y
CONFIG_POSIX_API=y
CONFIG_NET_LOG=y
CONFIG_NET_IPV6=y
CONFIG_NET_IPV4=y
CONFIG_NET_UDP=y
CONFIG_NET_TCP=y
CONFIG_NET_DHCPV4=y
CONFIG_DNS_RESOLVER=y

CONFIG_NET_STATISTICS=y
CONFIG_NET_STATISTICS_WIFI=y
CONFIG_NET_STATISTICS_USER_API=y

CONFIG_NET_PKT_RX_COUNT=8
CONFIG_NET_PKT_TX_COUNT=8
CONFIG_NET_CONFIG_SETTINGS=y
# Below section is the primary contributor to SRAM and is currently
# tuned for performance, but this will be revisited in the future.
CONFIG_NET_BUF_RX_COUNT=16
CONFIG_NET_BUF_TX_COUNT=16
CONFIG_NET_BUF_DATA_SIZE=1500
CONFIG_HEAP_MEM_POOL_SIZE=153600
CONFIG_NET_TC_TX_COUNT=1


CONFIG_NET_IF_UNICAST_IPV6_ADDR_COUNT=4
CONFIG_NET_IF_MCAST_IPV6_ADDR_COUNT=5
CONFIG_NET_MAX_CONTEXTS=5
CONFIG_NET_CONTEXT_SYNC_RECV=y

# static IP for DUT
CONFIG_NET_CONFIG_MY_IPV4_ADDR="192.168.87.99"
CONFIG_NET_CONFIG_MY_IPV4_NETMASK="255.255.255.0"
CONFIG_NET_CONFIG_MY_IPV4_GW="192.168.87.70"


CONFIG_INIT_STACKS=y

CONFIG_NET_L2_ETHERNET=y
CONFIG_NET_SHELL=y

CONFIG_SHELL_BACKEND_DUMMY=y
#CONFIG_SHELL_CMD_BUFF_SIZE=300

# Memories
CONFIG_MAIN_STACK_SIZE=8192
CONFIG_SHELL_STACK_SIZE=4096
CONFIG_SYSTEM_WORKQUEUE_STACK_SIZE=2048
CONFIG_NET_TX_STACK_SIZE=4096
CONFIG_NET_RX_STACK_SIZE=4096

# Debugging
CONFIG_STACK_SENTINEL=y
CONFIG_DEBUG_COREDUMP=y
CONFIG_DEBUG_COREDUMP_BACKEND_LOGGING=y
CONFIG_DEBUG_COREDUMP_MEMORY_DUMP_MIN=y
CONFIG_SHELL_CMDS_RESIZE=n
#CONFIG_DEBUG=y
CONFIG_WPA_SUPP_LOG_LEVEL_INF=y

# Kernel options
CONFIG_ENTROPY_GENERATOR=y

# Logging
CONFIG_LOG=y
CONFIG_PRINTK=y
CONFIG_SHELL=y
CONFIG_SHELL_GETOPT=y
CONFIG_DEVICE_SHELL=y
CONFIG_POSIX_CLOCK=y
CONFIG_DATE_SHELL=y
CONFIG_NET_CONFIG_AUTO_INIT=n
CONFIG_NET_SOCKETS_POLL_MAX=6

CONFIG_WIFI_MGMT_EXT=y
CONFIG_WIFI_CREDENTIALS=y
CONFIG_WIFI_CREDENTIALS_BACKEND_SETTINGS=y
CONFIG_FLASH=y
CONFIG_FLASH_PAGE_LAYOUT=y
CONFIG_FLASH_MAP=y
CONFIG_NVS=y
CONFIG_SETTINGS=y
CONFIG_SETTINGS_NVS=y
# Enabling Quick Track
CONFIG_NRF7002_QUICK_TRACK=y
CONFIG_REBOOT=y
```

## overlay-netusb.conf
```kconfig
# USB Device settings
CONFIG_USB_DEVICE_STACK=y

# Select USB Configurations
CONFIG_USB_DEVICE_NETWORK_ECM=y

# Logging
CONFIG_USB_DRIVER_LOG_LEVEL_INF=y
CONFIG_USB_DEVICE_LOG_LEVEL_INF=y
CONFIG_NET_IF_MAX_IPV4_COUNT=2
CONFIG_NET_IF_UNICAST_IPV4_ADDR_COUNT=2
```

## src/wfa_qt_shell.c
```c
#include <stdio.h>
#include <stdlib.h>
#include <ctype.h>
#include <malloc.h>

#include <zephyr/zephyr.h>
#include <zephyr/shell/shell.h>

static int cmd_wfa_qt_start(const struct shell *shell,
		size_t argc,
		const char *argv[])
{
	printf("arg0: %s\n", argv[0]);
	return qt_main(argc,
			argv);
}

SHELL_STATIC_SUBCMD_SET_CREATE(
		wfa_qt_cmds,
		SHELL_CMD(app,
			NULL,
			"\"Start C-APP\"",
			cmd_wfa_qt_start),
		SHELL_SUBCMD_SET_END
		);

/* "wfa_qt" shell tool for Wi-Fi alliance certification test */
SHELL_CMD_REGISTER(wfa_qt,
		&wfa_qt_cmds,
		"wfa_qt_commands (only for internal use)",
		NULL);
```

## src/wifi_main.c
```c
/*
 * Copyright (c) 2022 Nordic Semiconductor ASA
 *
 * SPDX-License-Identifier: LicenseRef-Nordic-5-Clause
 */

/** @file
 * @brief WiFi shell sample main function
 */

#include <stdio.h>
#include <zephyr/sys/printk.h>
#include <nrfx_clock.h>
#include <zephyr/device.h>

#include <zephyr/usb/usb_device.h>
#include <zephyr/net/net_config.h>


#define CONFIG_NET_CONFIG_USB_IPV4_ADDR "10.20.30.40"
int init_usb(void)
{
	int ret;

	ret = usb_enable(NULL);
	if (ret != 0) {
		printk("Cannot enable USB (%d)", ret);
		return ret;
	}

	return 0;
}

void main(void)
{
	struct in_addr addr;
	int ret;

#ifdef CLOCK_FEATURE_HFCLK_DIVIDE_PRESENT
	/* For now hardcode to 128MHz */
	nrfx_clock_divider_set(NRF_CLOCK_DOMAIN_HFCLK,
			NRF_CLOCK_HFCLK_DIV_1);
#endif
	printk("Starting %s with CPU frequency: %d MHz\n", CONFIG_BOARD, SystemCoreClock/MHZ(1));

	init_usb();
	/* Redirect static IP address to netusb*/
	const struct device *usb_dev = device_get_binding("eth_netusb");
	struct net_if *iface = net_if_lookup_by_dev(usb_dev);
	if (!iface) {
		printk("Cannot find network interface: %s", "eth_netusb");
		return;
	}
	if (sizeof(CONFIG_NET_CONFIG_USB_IPV4_ADDR) > 1) {
		if (net_addr_pton(AF_INET, CONFIG_NET_CONFIG_USB_IPV4_ADDR, &addr)) {
			printk("Invalid address: %s", CONFIG_NET_CONFIG_USB_IPV4_ADDR);
			return;
		}
		net_if_ipv4_addr_add(iface, &addr, NET_ADDR_MANUAL, 0);
	}
	if (sizeof(CONFIG_NET_CONFIG_MY_IPV4_NETMASK) > 1) {
		/* If not empty */
		if (net_addr_pton(AF_INET, CONFIG_NET_CONFIG_MY_IPV4_NETMASK, &addr)) {
			printk("Invalid netmask: %s", CONFIG_NET_CONFIG_MY_IPV4_NETMASK);
		} else {
			net_if_ipv4_set_netmask(iface, &addr);
		}
	}
	const struct device *dev = device_get_binding("wlan0");
	struct net_if *wifi_iface = net_if_lookup_by_dev(dev);
	if (!wifi_iface) {
		printk("Cannot find network interface: %s", "wlan0");
		return;
	}
	if (sizeof(CONFIG_NET_CONFIG_MY_IPV4_ADDR) > 1) {
		if (net_addr_pton(AF_INET, CONFIG_NET_CONFIG_MY_IPV4_ADDR, &addr)) {
			printk("Invalid address: %s", CONFIG_NET_CONFIG_MY_IPV4_ADDR);
			return;
		}
		ret = net_if_ipv4_addr_add(wifi_iface, &addr, NET_ADDR_MANUAL, 0);
		printk("ret:%d", ret);
	}
	if (sizeof(CONFIG_NET_CONFIG_MY_IPV4_NETMASK) > 1) {
		/* If not empty */
		if (net_addr_pton(AF_INET, CONFIG_NET_CONFIG_MY_IPV4_NETMASK, &addr)) {
			printk("Invalid netmask: %s", CONFIG_NET_CONFIG_MY_IPV4_NETMASK);
		} else {
			net_if_ipv4_set_netmask(wifi_iface, &addr);
		}
	}
	/* As both are Ethernet, we need to set specific interface*/
	net_if_set_default(wifi_iface);

	net_config_init_app(dev, "Initializing network");
	
}
```

## src/wifi_raw_tx_packet_shell.c
```c
/*
 * Copyright (c) 2023 Nordic Semiconductor ASA
 *
 * SPDX-License-Identifier: LicenseRef-Nordic-5-Clause
 */

/* @file
 * @brief Raw Tx Injection Shell 
 */

#include <zephyr/logging/log.h>
LOG_MODULE_REGISTER(raw_tx_packet_shell, CONFIG_LOG_DEFAULT_LEVEL);

#include <zephyr/shell/shell.h>
#include <zephyr/net/socket.h>

struct nrf_wifi_fmac_rawpkt_info {
	/* Magic number to distinguish packet is raw packet */
	unsigned int magic_number;
	/* Data rate of the packet */
	unsigned char data_rate;
	/* Packet length */
	unsigned short packet_length;
	/* Mode describing if packet is VHT, HT, HE or Legacy */
	unsigned char tx_mode;
	/* Wi-Fi access category mapping for packet */
	unsigned char queue;
	/* reserved parameter for driver */
	unsigned char reserved;
};

char beacon_frame[] = {
0x80, 0x00, 0x00, 0x00, 0xff, 0xff, 0xff, 0xff, 0xff, 0xff, 0xa0, 0x69, 0x60, 0xe3, 0x52, 0x15,
0xa0, 0x59, 0x50, 0xe3, 0x52, 0x15, 0xb0, 0x53,

0xf0, 0xcf, 0x29, 0x8e, 0x00, 0x00, 0x00, 0x00, 0x64, 0x00, 0x11, 0x04, 0x00, 0x15, 0x4E, 0x52,
0x46, 0x5F, 0x52, 0x41, 0x57, 0x5F, 0x54, 0x58, 0x5F, 0x50, 0x41, 0x43, 0x4B, 0x45, 0x54, 0x5F,
0x41, 0x50, 0x50, 0x54, 0x72, 0x61, 0x63, 0x6b, 0x5f, 0x31, 0x36, 0x38, 0x36, 0x31, 0x32, 0x32,
0x38, 0x36, 0x35, 0x01, 0x08, 0x82, 0x84, 0x8b, 0x96, 0x0c, 0x12, 0x18, 0x24, 0x03, 0x01, 0x06,
0x05, 0x04, 0x00, 0x02, 0x00, 0x00, 0x2a, 0x01, 0x04, 0x32, 0x04, 0x30, 0x48, 0x60, 0x6c, 0x30,
0x14, 0x01, 0x00, 0x00, 0x0f, 0xac, 0x04, 0x01, 0x00, 0x00, 0x0f, 0xac, 0x04, 0x01, 0x00, 0x00,
0x0f, 0xac, 0x02, 0xcc, 0x00, 0x3b, 0x02, 0x51, 0x00, 0x2d, 0x1a, 0x0c, 0x00, 0x17, 0xff, 0xff,
0x00, 0x00, 0x00, 0x00, 0x00, 0x00, 0x00, 0x2c, 0x01, 0x01, 0x00, 0x00, 0x00, 0x00, 0x00, 0x00,
0x00, 0x00, 0x00, 0x3d, 0x16, 0x06, 0x00, 0x00, 0x00, 0x00, 0x00, 0x00, 0x00, 0x00, 0x00, 0x00,
0x00, 0x00, 0x00, 0x00, 0x00, 0x00, 0x00, 0x00, 0x7f, 0x08, 0x04, 0x00, 0x00, 0x02, 0x00, 0x00,
0x00, 0x40, 0xff, 0x1a, 0x23, 0x01, 0x78, 0x10, 0x1a, 0x00, 0x00, 0x00, 0x20, 0x0e, 0x09, 0x00,
0x09, 0x80, 0x04, 0x01, 0xc4, 0x00, 0xfa, 0xff, 0xfa, 0xff, 0x61, 0x1c, 0xc7, 0x71, 0xff, 0x07,
0x24, 0xf0, 0x3f, 0x00, 0x81, 0xfc, 0xff, 0xdd, 0x18, 0x00, 0x50, 0xf2, 0x02, 0x01, 0x01, 0x01,
0x00, 0x03, 0xa4, 0x00, 0x00, 0x27, 0xa4, 0x00, 0x00, 0x42, 0x43, 0x5e, 0x00, 0x62, 0x32, 0x2f, 0x00
};

static void wifi_send_raw_tx_pkts(const char *transmission_mode, int num_packets,
				  int delay, int rate_flags,
				  int data_rate, int queue_number)
{
	struct sockaddr_ll sa;
	int sockfd, ret;
	struct net_if *iface;
	struct nrf_wifi_fmac_rawpkt_info raw_tx_pkt;
	char *buffer = NULL;
	int buf_length;

	/* Create a raw socket */
	sockfd = socket(AF_PACKET, SOCK_RAW, IPPROTO_RAW);
	if (sockfd < 0) {
		LOG_ERR("Unable to create a socket");
		return;
	}

	iface = net_if_get_default();
	if (!iface) {
		LOG_ERR("Unable to get default interface");
		return;
	}

	sa.sll_family = AF_PACKET;
	sa.sll_ifindex = net_if_get_by_iface(iface);

	/* Bind the socket */
	ret = bind(sockfd, (struct sockaddr *)&sa, sizeof(struct sockaddr_ll));
	if (ret < 0) {
		LOG_ERR("Error: Unable to bind socket to the network interface:%d", errno);
		close(sockfd);
		return;
	}

	/* Raw Tx Packet header */
	raw_tx_pkt.magic_number = 0x12345678;
	raw_tx_pkt.data_rate = data_rate;
	raw_tx_pkt.packet_length = sizeof(beacon_frame);
	raw_tx_pkt.tx_mode = rate_flags;
	raw_tx_pkt.queue = queue_number;
	raw_tx_pkt.reserved = 0;

	buffer = malloc(sizeof(struct nrf_wifi_fmac_rawpkt_info) + sizeof(beacon_frame));
	if (!buffer) {
		LOG_ERR("Malloc failed for send buffer");
		return;
	}

	buf_length = sizeof(struct nrf_wifi_fmac_rawpkt_info) + sizeof(beacon_frame);
	memcpy(buffer, &raw_tx_pkt, sizeof(struct nrf_wifi_fmac_rawpkt_info));

	memcpy(buffer + sizeof(struct nrf_wifi_fmac_rawpkt_info),
				beacon_frame, sizeof(beacon_frame));

	if (num_packets == 0 && strcmp(transmission_mode, "fixed") == 0) {
		LOG_ERR("Can't send %d number of raw tx packets", num_packets);
		close(sockfd);
		free(buffer);
		return;
	}

	while (1) {
		if (strcmp(transmission_mode, "fixed") == 0 && num_packets == 0) {
			break;
		}

		ret = sendto(sockfd, buffer, buf_length, 0,
				(struct sockaddr *)&sa, sizeof(sa));
		if (ret < 0) {
			LOG_ERR("Unable to send beacon frame");
			close(sockfd);
			free(buffer);
			return;
		}

		if (strcmp(transmission_mode, "fixed") == 0 && num_packets > 0) {
			num_packets--;
		}

		k_sleep(K_MSEC(delay));
	}

	/* close the socket */
	close(sockfd);
	free(buffer);
}

static int cmd_wifi_send_packet(const struct shell *shell,
			  size_t argc,
			  const char *argv[])
{
	const char *mode = NULL;
	int num_packets = 0, delay, rate_flags, data_rate, queue_number;

	if (argc < 7) {
		shell_fprintf(shell, SHELL_WARNING,
			"Invalid arguments. Usage: %s <continuous/fixed> <num_packets> <delay>\n", argv[0]);
		return 1;
	}

	mode = argv[1];
	LOG_INF("TRIVENI: Priniting arg[1] : %s", mode);

	if (argc == 7) {
		num_packets = atoi(argv[2]);
	}

	delay = atoi(argv[argc - 5]); // Use the correct index based on the number of arguments
	rate_flags = atoi(argv[argc - 4]); // Use the correct index based on the number of arguments
	data_rate = atoi(argv[argc - 3]);  // Use the correct index based on the number of arguments
	queue_number = atoi(argv[argc - 2]);  // Use the correct index based on the number of arguments

	wifi_send_raw_tx_pkts(mode, num_packets, delay, rate_flags, data_rate, queue_number);

	return 0;
}

SHELL_STATIC_SUBCMD_SET_CREATE(
	raw_tx_cmds,
	SHELL_CMD(send,
		  NULL,
		  "To send a raw TX packet",
		  cmd_wifi_send_packet),
	SHELL_SUBCMD_SET_END);

SHELL_CMD_REGISTER(raw_tx_packet,
		&raw_tx_cmds,
		"raw_tx_cmds (To send raw TX packets)",
		NULL);
```
